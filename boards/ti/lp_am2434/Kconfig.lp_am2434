## boards/ti/lp_am2434/Kconfig.lp_am2434
```kconfig
# Texas Instruments LP-AM2434
#
# Copyright (c) 2025 Texas Instruments Incorporated
#
# SPDX-License-Identifier: Apache-2.0

config BOARD_LP_AM2434
	select SOC_AM2434_MAIN_R5F0_0 if BOARD_LP_AM2434_MAIN_R5F0_0
```

## boards/ti/lp_am2434/board.yml
```yaml
board:
  name: lp_am2434
  full_name: LP_AM2434
  vendor: ti
  socs:
  - name: am2434
```

## soc/ti/k3/am2x/Kconfig
```kconfig
# Copyright (c) 2023 Enphase Energy
# SPDX-License-Identifier: Apache-2.0

config SOC_SERIES_AM2X_R5
	select ARM
	select CPU_CORTEX_R5
	select CPU_HAS_ARM_MPU
	select VFP_SP_D16
	select ARM_CUSTOM_INTERRUPT_CONTROLLER
	select VIM
	select TI_DM_TIMER
	select OPENAMP_RSC_TABLE
	select UART_NS16550_ACCESS_WORD_ONLY if UART_NS16550
	select SOC_EARLY_INIT_HOOK

config SOC_PART_NUMBER
	default "J721e" if SOC_AM2434_MAIN_R5F0_0
```
