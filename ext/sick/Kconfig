## ext/sick/Kconfig
```kconfig
# Kconfig - external HAL source code configuration options

#
# Copyright (c) 2016-2017 Linaro Ltd.
#
# SPDX-License-Identifier: Apache-2.0
#

# When adding new entries keep the list in alphabetical order

menu "SICK"



config EDP_BASE
  bool "Enable EDP BASE"
  select PRINTK
  select LOG
  select CPLUSPLUS
  select NEWLIB_LIBC
  select RTTI
  help
    This option enables EDP BASE

config EDP_CMNALG
  bool "Enable EDP CmnAlg"
  select EDP_BASE
  help
    This option enables EDP CmnAlg
endmenu
```
